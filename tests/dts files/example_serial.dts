serial@ff010000 {
    u-boot,dm-pre-reloc;
    compatible = "cdns,uart-r1p12", "xlnx,xuartps";
    status = "okay";
    interrupt-parent = <0x4>;
    interrupts = <0x0 0x16 0x4>;
    reg = <0x0 0xff010000 0x0 0x1000>;
    clock-names = "uart_clk", "pclk";
    power-domains = <0x26 0x22>;
    clocks = <0x3 0x39 0x3 0x1f>;
    pinctrl-names = "default";
    pinctrl-0 = <0x38>;
    cts-override;
    device_type = "serial";
    port-number = <0x1>;
    xen,passthrough; /* add this line */
};
